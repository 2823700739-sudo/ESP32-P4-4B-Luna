## firmware/luna-panel/main/Kconfig.projbuild
```kconfig
menu "Luna Current Product"

    config LUNA_BLE_B0
        bool "Build the isolated Luna BLE B0 diagnostic application"
        default n
        depends on BT_NIMBLE_ENABLED && ESP_HOSTED_ENABLE_BT_NIMBLE
        help
            Minimal paired GATT hello/ping/time diagnostic only. Does not start
            USB CDC, the old HTTP Agent client, music, or cover tasks.
            Use the separate build-firmware.ps1 -BleB0 profile.

    config LUNA_BLE_B0_LEGACY_HCI_PROBE
        bool "Allow diagnostic HCI probe for old pre-2.5.2 C6 firmware"
        default n
        depends on LUNA_BLE_B0
        help
            Old Hosted firmware enables its Bluetooth controller at boot and
            lacks the newer controller-init RPC. If both version and init RPCs
            fail, try NimBLE HCI synchronization, without changing C6 flash.
            Diagnostic only; failure is not evidence of a working controller.

    config LUNA_BLE_B0_WIFI_TEST
        bool "Run device weather Wi-Fi alongside the B0 BLE diagnostic"
        default n
        depends on LUNA_BLE_B0
        help
            Optional coexistence gate using current C6 firmware, local Wi-Fi
            credentials and the weather location/cache already saved in NVS.
            Does not start the PC HTTP channel, NTP or USB CDC. BLE supplies
            valid time before HTTPS. No restore of a saved timestamp as a clock.

    config LUNA_BLE_B1_MUSIC
        bool "Run the current five-card Luna product"
        default n
        depends on LUNA_BLE_B0
        help
            Reuse the secured BLE transport with bounded music snapshots and
            a non-replaying action FIFO. Fixed player, no covers/USB/PC HTTP.
            Five approved cards, interactive pet and independent weather.

    config LUNA_WIFI_SSID
        string "2.4 GHz Wi-Fi SSID"
        default ""
        help
            Network name used by the Luna firmware. Stored only in the generated sdkconfig.

    config LUNA_WIFI_PASSWORD
        string "Wi-Fi password"
        default ""
        help
            Network password used by the Luna firmware. Stored only in the generated sdkconfig.

endmenu
```

## firmware/luna-panel/sdkconfig.defaults
```kconfig
CONFIG_IDF_TARGET="esp32p4"

# Board memory and display
CONFIG_BSP_LCD_TYPE_720_720_4_INCH=y
CONFIG_ESPTOOLPY_FLASHMODE_QIO=y
CONFIG_ESPTOOLPY_FLASHSIZE_32MB=y
CONFIG_ESPTOOLPY_FLASHSIZE="32MB"
CONFIG_PARTITION_TABLE_CUSTOM=y
CONFIG_PARTITION_TABLE_CUSTOM_FILENAME="partitions.csv"
CONFIG_PARTITION_TABLE_OFFSET=0x10000
CONFIG_SPIRAM=y
CONFIG_SPIRAM_XIP_FROM_PSRAM=y
CONFIG_CACHE_L2_CACHE_256KB=y
CONFIG_CACHE_L2_CACHE_LINE_64B=y

# Runtime
CONFIG_COMPILER_OPTIMIZATION_PERF=y
CONFIG_ESP_MAIN_TASK_STACK_SIZE=10240
CONFIG_FREERTOS_HZ=1000

# LVGL 9
CONFIG_LV_USE_CLIB_MALLOC=y
CONFIG_LV_USE_CLIB_STRING=y
CONFIG_LV_USE_CLIB_SPRINTF=y
CONFIG_LV_DEF_REFR_PERIOD=15
CONFIG_LV_OS_FREERTOS=y
CONFIG_LV_DRAW_SW_DRAW_UNIT_CNT=2
CONFIG_LV_ATTRIBUTE_FAST_MEM_USE_IRAM=n
CONFIG_LV_FONT_MONTSERRAT_16=y
CONFIG_LV_FONT_MONTSERRAT_20=y
CONFIG_LV_FONT_MONTSERRAT_24=y
CONFIG_LV_FONT_MONTSERRAT_48=y

# ESP32-C6 hosted Wi-Fi transport
CONFIG_ESP_WIFI_SOFTAP_SUPPORT=n
CONFIG_ESP_WIFI_REMOTE_ENABLED=y
CONFIG_SLAVE_IDF_TARGET_ESP32C6=y
CONFIG_ESP_HOSTED_CP_TARGET_ESP32C6=y
CONFIG_ESP_HOSTED_P4_DEV_BOARD_FUNC_BOARD=y
CONFIG_ESP_HOSTED_MEMPOOL_PREFER_SPIRAM=y

# Validate HTTPS weather responses against the ESP-IDF root certificate bundle.
CONFIG_MBEDTLS_CERTIFICATE_BUNDLE=y
```
